## main/Kconfig.projbuild
```kconfig
menu "Band Decoder Board"

choice BOARD_MODEL
    prompt "Target KinCony board"
    default BOARD_KC868_A16
    help
        Selects the KinCony KC868 board variant this firmware runs on.

        KC868-A16: 16 relays and 16 optocoupler inputs. Two PCF8574 output
        expanders (0x24/0x25) and two input expanders (0x22/0x21). Supports
        single- and dual-radio (alternating/concurrent) antenna switching.

        KC868-A8: 8 relays and 8 optocoupler inputs. One PCF8574 output
        expander (0x24) and one input expander (0x22). Runs single-radio
        (Radio A) only, up to 8 antenna ports on relays 1-8.

        KC868-A6 (classic ESP32, PCB v1.4): 6 relays and 6 inputs. Same
        single PCF8574 output (0x24) / input (0x22) topology as the A8, but
        I2C SCL is on GPIO15 instead of GPIO5, and the RS232/CAT port is on
        GPIO16 (RX) / GPIO17 (TX) instead of the A16's HT header (GPIO32/33).
        Single-radio only, up to 6 antenna ports. (The ESP32-S3 "A6v3" is a
        different target and is not this option.)

config BOARD_KC868_A16
    bool "KC868-A16 (16 relays / 16 inputs, single or dual radio)"

config BOARD_KC868_A8
    bool "KC868-A8 (8 relays / 8 inputs, single radio only)"

config BOARD_KC868_A6
    bool "KC868-A6 (6 relays / 6 inputs, single radio only, SCL=GPIO15)"

endchoice

endmenu
```
